## devtank-prod-tester/Config.in
```kconfig
config BR2_PACKAGE_DEVTANK_PROD_TESTER
	bool "devtank_prod-tester"
	depends on BR2_PACKAGE_PYTHON_GOBJECT
	depends on BR2_PACKAGE_LIBGTK3
	depends on BR2_PACKAGE_LIBGTK3_BROADWAY
	depends on BR2_PACKAGE_LIBGTK3_X11
	depends on BR2_PACKAGE_PYTHON_PYCAIRO
	depends on BR2_PACKAGE_PYTHON_NETIFACES
	depends on BR2_PACKAGE_PYTHON_PARAMIKO
	depends on BR2_PACKAGE_PYTHON_DATEUTIL
	depends on BR2_PACKAGE_PYTHON_TZ
	depends on BR2_PACKAGE_LIBYAML
	depends on BR2_PACKAGE_LIBIIO
	help
	  Devtank Prod Tester
	  
	  Devtank production tester example
```

## hiltop_defconfig
```kconfig
BR2_arm=y
BR2_cortex_a53=y
BR2_ARM_FPU_NEON_VFPV4=y
BR2_GLOBAL_PATCH_DIR="board/hiltop/patches"
BR2_TOOLCHAIN_BUILDROOT_GLIBC=y
BR2_BINUTILS_VERSION_2_32_X=y
BR2_GCC_VERSION_8_X=y
BR2_TOOLCHAIN_BUILDROOT_CXX=y
BR2_TARGET_GENERIC_HOSTNAME="devtank-example"
BR2_TARGET_GENERIC_ISSUE="Welcome to Devtank Hiltop"
BR2_ROOTFS_DEVICE_CREATION_DYNAMIC_EUDEV=y
BR2_TARGET_GENERIC_ROOT_PASSWD="cheesybeans"
# BR2_TARGET_GENERIC_REMOUNT_ROOTFS_RW is not set
BR2_SYSTEM_DHCP="eth0"
BR2_ENABLE_LOCALE_WHITELIST="C en_GB"
BR2_TARGET_TZ_INFO=y
BR2_TARGET_LOCALTIME="Europe/London"
BR2_ROOTFS_OVERLAY="board/hiltop/rootfs_overlay"
BR2_ROOTFS_POST_BUILD_SCRIPT="board/hiltop/post-build.sh"
BR2_ROOTFS_POST_IMAGE_SCRIPT="board/hiltop/post-image.sh"
BR2_LINUX_KERNEL=y
BR2_LINUX_KERNEL_CUSTOM_GIT=y
BR2_LINUX_KERNEL_CUSTOM_REPO_URL="https://github.com/raspberrypi/linux.git"
BR2_LINUX_KERNEL_CUSTOM_REPO_VERSION="58f672b8"
BR2_LINUX_KERNEL_DEFCONFIG="bcm2837_hiltop"
BR2_LINUX_KERNEL_DTS_SUPPORT=y
BR2_LINUX_KERNEL_INTREE_DTS_NAME="bcm2710-rpi-cm3"
BR2_LINUX_KERNEL_NEEDS_HOST_OPENSSL=y
BR2_PACKAGE_LINUX_TOOLS_GPIO=y
BR2_PACKAGE_LINUX_TOOLS_IIO=y
BR2_PACKAGE_LZOP=y
BR2_PACKAGE_EXFAT=y
BR2_PACKAGE_LIBERATION=y
BR2_PACKAGE_ADWAITA_ICON_THEME=y
BR2_PACKAGE_FBGRAB=y
BR2_PACKAGE_FBV=y
# BR2_PACKAGE_FBV_JPEG is not set
BR2_PACKAGE_MESA3D=y
BR2_PACKAGE_MESA3D_GALLIUM_DRIVER_V3D=y
BR2_PACKAGE_MESA3D_GALLIUM_DRIVER_VC4=y
BR2_PACKAGE_MESA3D_OPENGL_GLX=y
BR2_PACKAGE_MESA3D_OPENGL_ES=y
BR2_PACKAGE_XORG7=y
BR2_PACKAGE_XSERVER_XORG_SERVER=y
BR2_PACKAGE_XAPP_XINPUT=y
BR2_PACKAGE_XAPP_XRANDR=y
BR2_PACKAGE_XAPP_XSETROOT=y
BR2_PACKAGE_XDRIVER_XF86_INPUT_EVDEV=y
BR2_PACKAGE_XDRIVER_XF86_INPUT_KEYBOARD=y
BR2_PACKAGE_XDRIVER_XF86_INPUT_MOUSE=y
BR2_PACKAGE_XDRIVER_XF86_VIDEO_FBTURBO=y
BR2_PACKAGE_XCURSOR_TRANSPARENT_THEME=y
BR2_PACKAGE_RPI_FIRMWARE=y
BR2_PACKAGE_DFU_UTIL=y
BR2_PACKAGE_EUDEV_RULES_GEN=y
BR2_PACKAGE_EVTEST=y
BR2_PACKAGE_FLASHROM=y
BR2_PACKAGE_PYTHON3=y
BR2_PACKAGE_PYTHON3_SQLITE=y
BR2_PACKAGE_PYTHON_AENUM=y
BR2_PACKAGE_PYTHON_DATEUTIL=y
BR2_PACKAGE_PYTHON_GOBJECT=y
BR2_PACKAGE_PYTHON_NETIFACES=y
BR2_PACKAGE_PYTHON_PARAMIKO=y
BR2_PACKAGE_PYTHON_PYASN1=y
BR2_PACKAGE_PYTHON_PYCAIRO=y
BR2_PACKAGE_PYTHON_PYINOTIFY=y
BR2_PACKAGE_PYTHON_PYMODBUS=y
BR2_PACKAGE_PYTHON_PYTZ=y
BR2_PACKAGE_PYTHON_PYYAML=y
BR2_PACKAGE_PYTHON_TZ=y
BR2_PACKAGE_CAIRO_XML=y
BR2_PACKAGE_LIBDRI2=y
BR2_PACKAGE_LIBGTA=y
BR2_PACKAGE_LIBGTK3=y
# BR2_PACKAGE_LIBGTK3_WAYLAND is not set
BR2_PACKAGE_LIBIIO=y
# BR2_PACKAGE_LIBIIO_XML_BACKEND is not set
# BR2_PACKAGE_LIBIIO_NETWORK_BACKEND is not set
# BR2_PACKAGE_LIBIIO_USB_BACKEND is not set
# BR2_PACKAGE_LIBIIO_SERIAL_BACKEND is not set
# BR2_PACKAGE_LIBIIO_IIOD is not set
BR2_PACKAGE_LIBXML2=y
BR2_PACKAGE_LIBSIGC=y
BR2_PACKAGE_DEVTANK_PROD_TESTER=y
BR2_PACKAGE_DROPBEAR=y
BR2_PACKAGE_IPTABLES=y
BR2_PACKAGE_NETPLUG=y
BR2_PACKAGE_NTP=y
BR2_PACKAGE_AT=y
BR2_TARGET_ROOTFS_EXT2=y
BR2_TARGET_ROOTFS_EXT2_4=y
BR2_TARGET_ROOTFS_EXT2_LABEL=""
BR2_TARGET_ROOTFS_EXT2_SIZE="1G"
# BR2_TARGET_ROOTFS_TAR is not set
BR2_PACKAGE_HOST_DOSFSTOOLS=y
BR2_PACKAGE_HOST_GENIMAGE=y
BR2_PACKAGE_HOST_MTOOLS=y
BR2_PACKAGE_HOST_PKGCONF=y
BR2_PACKAGE_HOST_PYTHON3=y
```

## python-tz/Config.in
```kconfig
config BR2_PACKAGE_PYTHON_TZ
	bool "python-tz"
	help
	  pytz brings the Olson tz database into Python.

	  This library allows accurate and cross platform timezone calculations using Python 2.4 or higher. It also solves the issue of ambiguous times at the end of daylight saving time, which you can read more about in the Python Library Reference (datetime.tzinfo).
	  
	  Almost all of the Olson timezones are supported.
```
